## configs/netcube_nagami_basic_carrier_defconfig
```kconfig
CONFIG_ARM=y
CONFIG_ARCH_SUNXI=y
CONFIG_DEFAULT_DEVICE_TREE="sun8i-t113s-netcube-nagami-basic-carrier"
CONFIG_SPL=y
CONFIG_DRAM_SUNXI_ODT_EN=0
CONFIG_DRAM_SUNXI_TPR0=0x004a2195
CONFIG_DRAM_SUNXI_TPR11=0x340000
CONFIG_DRAM_SUNXI_TPR12=0x46
CONFIG_DRAM_SUNXI_TPR13=0x34000100
CONFIG_MACH_SUN8I_R528=y
CONFIG_DRAM_CLK=792
CONFIG_DRAM_ZQ=8092667
CONFIG_SUNXI_MINIMUM_DRAM_MB=128
CONFIG_MMC_SUNXI_SLOT_EXTRA=2
# CONFIG_SYS_MALLOC_CLEAR_ON_INIT is not set
CONFIG_BOOTDELAY=1
CONFIG_PREBOOT=""
# CONFIG_SYS_DEVICE_NULLDEV is not set
# CONFIG_SYS_MMCSD_FS_BOOT is not set
CONFIG_SYS_PROMPT="Nagami> "
CONFIG_CMD_EEPROM=y
CONFIG_SYS_I2C_EEPROM_BUS=1
CONFIG_CMD_I2C=y
CONFIG_ENV_IS_IN_MMC=y
CONFIG_ENV_VARS_UBOOT_RUNTIME_CONFIG=y
CONFIG_USE_HOSTNAME=y
CONFIG_HOSTNAME="nagami"
CONFIG_VERSION_VARIABLE=y
CONFIG_NO_NET=y
# CONFIG_USB_FUNCTION_FASTBOOT is not set
CONFIG_SYS_I2C_MVTWSI=y
CONFIG_MISC=y
CONFIG_NVMEM=y
CONFIG_I2C_EEPROM=y
CONFIG_SYS_I2C_EEPROM_ADDR=0x50
CONFIG_SUPPORT_EMMC_BOOT=y
CONFIG_CONS_INDEX=4
CONFIG_USB_EHCI_HCD=y
CONFIG_USB_OHCI_HCD=y
CONFIG_USB_MUSB_HOST=y
CONFIG_USB_MUSB_GADGET=y
```
